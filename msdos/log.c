#include <fcntl.h>
#include <io.h>
#include <dos.h>
#include <alloc.h>
#include <process.h>
#include <string.h>

unsigned long vect;
unsigned char *buffer;
#define bfsize ((unsigned)50*1024)
unsigned size=0;

void interrupt i29(unsigned bp,unsigned di,unsigned si,unsigned ds,unsigned es,
		   unsigned dx,unsigned cx,unsigned bx,unsigned ax)
{
if(size!=bfsize) buffer[size++]=ax;
*(unsigned long far *)0x000000a4=vect;
_AX=ax;
_BX=bx;
_CX=cx;
_DX=dx;
geninterrupt(0x29);
ax=_AX;
bx=_BX;
cx=_CX;
dx=_DX;
*(unsigned long far *)0x000000a4=(unsigned long)i29;
}

#define sc(a) a,(sizeof(a)-1)

int main(int argc,char *argv[])
{
char cmd[160];
int logfile;
unsigned x;
if(argc<3)
 {
 _write(0,sc("COMMAND FORMAT: log logfile command\r\n"
 "\n\'log\' is a program which records up to 50K of command output (I.E,\r\n"
 "whatever is sent to the screen through MS-DOS) in a file.\r\n"
 "This program captures everything given to INT 0x29- the undocumented but\r\n"
 "standard MS-DOS console output routine.  The command output is recorded in\r\n"
 "a ram buffer- no DOS calls are made until the command exits.  When the buffer\r\n"
 "gets filled, any additional output is not recorded.\r\n"
 "\nFor example, the command: log test.log tcc -I\\tc test.c\r\n"
 "will save all the compiler error messages generated by tcc in the file test.log\r\n"
 "\nUse \"command.com\" as the command to log an entire shell session.  When the\r\n"
 "shell session is complete, type EXIT to stop recording.\r\n"
 "\nProgram written by: Joseph H. Allen (jhallen@wpi.wpi.edu)\r\n"
 "                on: 10/9/89         (or 508-792-3897)\r\n"
 "This program is released into the public domain and is without warranty\r\n"
 "Free virus also included :-) (just kidding)\r\n"));
 return(1);
 }
cmd[0]=0;
strcpy(cmd,argv[2]);
for(x=3;x<argc;x++)
 strcat(cmd," "), strcat(cmd,argv[x]);
logfile=_creat(argv[1],0);
if(logfile== -1)
 {
 _write(0,sc("log: Couldn't open log file"));
 return(1);
 }
buffer=malloc(bfsize);
_write(0,sc("log: Logging started\r\n"));
vect= *(unsigned long far *)(0x000000a4);
*(unsigned long far *)(0x000000a4)= (unsigned long)i29;
system(cmd);
*(unsigned long far *)(0x000000a4)= vect;
_write(logfile,buffer,size);
_close(logfile);
_write(0,sc("\r\nlog: Logging finished\r\n"));
return 0;
}
